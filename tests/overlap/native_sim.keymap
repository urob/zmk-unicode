#include "../behavior_keymap.dtsi"

&uc {
    default-mode = <UC_MODE_LINUX>;
};

&kscan {
    events = <
        ZMK_MOCK_PRESS(0,0,1)
        ZMK_MOCK_PRESS(0,0,1)
        ZMK_MOCK_RELEASE(0,0,1)
        ZMK_MOCK_RELEASE(0,0,200)
    >;
};
