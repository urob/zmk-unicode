/*
 * Copyright (c) 2025 The ZMK Contributors
 *
 * SPDX-License-Identifier: MIT
 */

#include <behaviors/mask_mods.dtsi>
#include <dt-bindings/zmk-unicode/uc.h>

/ {
    behaviors {
#if ZMK_BEHAVIOR_OMIT(UC)
        /omit-if-no-ref/
#endif
        uc: unicode {
            compatible = "zmk,behavior-unicode";
            #binding-cells = <2>;
            display-name = "Unicode input";
            default-mode = <UC_MODE_WIN_COMPOSE>;
        };
    };
};
