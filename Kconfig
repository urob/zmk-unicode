## Kconfig
```kconfig
menu "Unicode options"

config ZMK_UNICODE_TAP_MS
    int "Time to wait (in milliseconds) between the press and release of each key in the unicode sequence."
    default 5

config ZMK_UNICODE_WAIT_MS
    int "Time to wait (in milliseconds) between unicode tapping keys in the unicode sequence."
    default 0

#Unicode options
endmenu

DT_COMPAT_ZMK_BEHAVIOR_UNICODE := zmk,behavior-unicode

config ZMK_BEHAVIOR_UNICODE
    bool
    default $(dt_compat_enabled,$(DT_COMPAT_ZMK_BEHAVIOR_UNICODE))

DT_COMPAT_ZMK_BEHAVIOR_UNICODE_INPUT_SYSTEM := zmk,behavior-unicode-input-system

config ZMK_BEHAVIOR_UNICODE_INPUT_SYSTEM
    bool
    default $(dt_compat_enabled,$(DT_COMPAT_ZMK_BEHAVIOR_UNICODE_INPUT_SYSTEM))

DT_COMPAT_ZMK_BEHAVIOR_MASK_MODS := zmk,behavior-mask-mods

config ZMK_BEHAVIOR_MASK_MODS
    bool
    default $(dt_compat_enabled,$(DT_COMPAT_ZMK_BEHAVIOR_MASK_MODS))
```

## dts/bindings/behaviors/zmk,behavior-mask-mods.yaml
```yaml
# Copyright (c) 2025 The ZMK Contributors
# SPDX-License-Identifier: MIT

description: Mask mods behavior

compatible: "zmk,behavior-mask-mods"

include: one_param.yaml
```

## dts/bindings/behaviors/zmk,behavior-unicode-input-system.yaml
```yaml
# Copyright (c) 2025 The ZMK Contributors
# SPDX-License-Identifier: MIT

description: Unicode behavior

compatible: "zmk,behavior-unicode-input-system"

include: one_param.yaml

properties:
  default-mode:
    type: int
    required: true
    description: Default input mode.

  macos-key:
    type: int
    required: false
    description: "Key to initialize macOS (default: LALT)."

  linux-key:
    type: int
    required: false
    description: "Key to initialize Linux (default: LC(LS(U)))."

  linux-key-alt:
    type: int
    required: false
    description: "Key to initialize Linux-alt (default: LC(LSHFT))."

  win-compose-key:
    type: int
    required: false
    description: "Key to initialize WinCompose (default: RALT)."
```

## dts/bindings/behaviors/zmk,behavior-unicode.yaml
```yaml
# Copyright (c) 2025 The ZMK Contributors
# SPDX-License-Identifier: MIT

description: Unicode behavior

compatible: "zmk,behavior-unicode"

include: two_param.yaml

properties:
  default-mode:
    type: int
    required: true
    description: "Default input mode."

  minimum-length:
    type: int
    description: "Sequences are padded with leading zeros until minimum-length."
    default: 0

  macos-key:
    type: int
    description: "Key to initialize macOS (default: LALT)."

  linux-key:
    type: int
    description: "Key to initialize Linux (default: LC(LS(U)))."

  linux-key-alt:
    type: int
    description: "Key to initialize Linux-alt (default: LC(LSHFT))."

  win-compose-key:
    type: int
    description: "Key to initialize WinCompose (default: RALT)."
```
